## conf/layer.conf
```bitbake
# We have a conf and classes directory, append to BBPATH
BBPATH .= ":${LAYERDIR}"

# We have a recipes directory containing .bb and .bbappend files, add to BBFILES
BBFILES += "${LAYERDIR}/recipes*/*/*.bb \
            ${LAYERDIR}/recipes*/*/*.bbappend"

BBFILE_COLLECTIONS += "sampleqtgui"
BBFILE_PATTERN_sampleqtgui := "^${LAYERDIR}/"
BBFILE_PRIORITY_sampleqtgui = "10"

LAYERSERIES_COMPAT_sampleqtgui = "thud zeus dunfell"
```
